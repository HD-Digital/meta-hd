## conf/machine/hd11.conf
```bitbake
#@TYPE: Machine
#@NAME: hd11
#@DESCRIPTION: Machine configuration for the hd11

MKUBIFS_ARGS = "-m 2048 -e 126976 -c 8192"
UBINIZE_ARGS = "-m 2048 -p 128KiB"

DVBMEDIASINK_CONFIG =+ "--with-h265 --with-vb8"

CHIPSET = "bcm73625"
RCTYPE = "16"

require conf/machine/include/hd-mipsel.inc
```

## conf/machine/hd1100.conf
```bitbake
#@TYPE: Machine
#@NAME: hd1100
#@DESCRIPTION: Machine configuration for the hd1100

MKUBIFS_ARGS = "-m 2048 -e 126976 -c 4096"
UBINIZE_ARGS = "-m 2048 -p 128KiB"

MACHINE_FEATURES += "textlcd"

CHIPSET = "bcm7358"
TARGET_FPU = "soft"
RCTYPE = "16"

require conf/machine/include/hd.inc

MACHINE_EXTRA_RDEPENDS += "enigma2-plugin-extensions-vfdcontrol"
```

## conf/machine/hd1265.conf
```bitbake
#@TYPE: Machine
#@NAME: hd1265
#@DESCRIPTION: Machine configuration for the hd1265

MKUBIFS_ARGS = "-m 2048 -e 126976 -c 8192"
UBINIZE_ARGS = "-m 2048 -p 128KiB"

MACHINE_FEATURES += "textlcd"
DVBMEDIASINK_CONFIG =+ "--with-h265"

CHIPSET = "bcm73625"
RCTYPE = "16"

require conf/machine/include/hd.inc

MACHINE_EXTRA_RDEPENDS += "enigma2-plugin-extensions-vfdcontrol"
```

## conf/machine/hd1500.conf
```bitbake
#@TYPE: Machine
#@NAME: hd1500
#@DESCRIPTION: Machine configuration for the hd1500

MKUBIFS_ARGS = "-m 2048 -e 126976 -c 8192"
UBINIZE_ARGS = "-m 2048 -p 128KiB"

MACHINE_FEATURES += "textlcd"
DVBMEDIASINK_CONFIG =+ "--with-h265 --with-vb8"

CHIPSET = "bcm73625"
RCTYPE = "16"

require conf/machine/include/hd-mipsel.inc

MACHINE_EXTRA_RDEPENDS += "enigma2-plugin-extensions-vfdcontrol"
```

## conf/machine/hd2400.conf
```bitbake
#@TYPE: Machine
#@NAME: hd2400
#@DESCRIPTION: Machine configuration for the hd2400

MACHINE_FEATURES += "dvb-c"

MKUBIFS_ARGS = "-m 2048 -e 126976 -c 8192"
UBINIZE_ARGS = "-m 2048 -p 128KiB"

CHIPSET = "bcm7425"
TARGET_FPU = "hard"

require conf/machine/include/hd.inc
```

## conf/machine/hd51.conf
```bitbake
#@TYPE: Machine
#@NAME: hd51
#@DESCRIPTION: Machine configuration for the hd51

MACHINE_FEATURES += "dvb-c textlcd"
OPENPLI_FEATURES += "ci"

CHIPSET = "bcm7251s"
RCTYPE = "16"

require conf/machine/include/hd-armv7a.inc
```

## conf/machine/hd530c.conf
```bitbake
#@TYPE: Machine
#@NAME: hd530c
#@DESCRIPTION: Machine configuration for the hd530c

MKUBIFS_ARGS = "-m 2048 -e 126976 -c 8192"
UBINIZE_ARGS = "-m 2048 -p 128KiB"

MACHINE_FEATURES += "textlcd dvb-c"

CHIPSET = "bcm7584"
RCTYPE = "16"

require conf/machine/include/hd-mipsel.inc

MACHINE_EXTRA_RDEPENDS += "enigma2-plugin-extensions-vfdcontrol"
```

## conf/machine/include/hd-arm.inc
```bitbake
DVBMEDIASINK_CONFIG += "--with-h265 --with-vb8 --with-vb9 --with-opus"

IMAGE_CLASSES += "hd-emmc_image_multi"
IMAGE_FSTYPES += "hd-emmc"
IMAGE_ROOTFS_SIZE ?= "196608"

TARGET_ARCH = "arm"
DEFAULTTUNE ?= "armv7ahf-neon"

PREFERRED_PROVIDER_virtual/kernel = "linux-hd4k"

IMAGEVERSION := "${DISTRO_NAME}-${DISTRO_VERSION}-${DATE}"
IMAGEVERSION[vardepsexclude] = "DATE"

IMAGE_CMD_hd-emmc_append = "\
	mkdir -p ${IMGDEPLOYDIR}/${IMAGEDIR}; \
	cp ${IMGDEPLOYDIR}/${IMAGE_NAME}.emmc.img ${IMGDEPLOYDIR}/${IMAGEDIR}/disk.img; \
	echo "${IMAGEVERSION}" > ${IMGDEPLOYDIR}/${IMAGEDIR}/imageversion; \
	cd ${IMGDEPLOYDIR}; \
	zip ${DISTRO_NAME}-${DISTRO_VERSION}-${MACHINE}_usb.zip ${IMAGEDIR}/*; \
	rm -Rf ${IMAGEDIR}; \
	rm -Rf ${IMGDEPLOYDIR}/boot; \
	"

IMAGE_CMD_hd_emmc_prepend = " \
	rm -Rf ${IMGDEPLOYDIR}/boot; \
	mkdir ${IMGDEPLOYDIR}/boot; \
	echo "LABEL=${DISTRO_NAME}${DISTRO_VERSION}" > ${IMGDEPLOYDIR}/boot/boot.cfg; \
	echo "KERNEL=/boot/kernel.bin" >> ${IMGDEPLOYDIR}/boot/boot.cfg; \
	echo "PRIORITY=100" >> ${IMGDEPLOYDIR}/boot/boot.cfg; \
	rm -Rf ${IMAGE_ROOTFS}/tmp/*; \
	"

require conf/machine/include/arm/arch-armv7a.inc
require conf/machine/include/hd.inc
```

## conf/machine/include/hd-armv7a.inc
```bitbake
PREFERRED_VERSION_linux-hd = "4.10.6"

IMAGE_CLASSES += "hd-emmc_image_multi"
IMAGE_FSTYPES += "hd-emmc"
IMAGE_ROOTFS_SIZE ?= "294912"

TARGET_ARCH = "arm"
DEFAULTTUNE ?= "armv7ahf-neon"

require conf/machine/include/arm/arch-armv7a.inc
require conf/machine/include/hd.inc
```

## conf/machine/include/hd-mipsel.inc
```bitbake
IMAGE_FSTYPES += "ubi"
UBI_VOLNAME = "rootfs"

TARGET_ARCH = "mipsel"
DEFAULTTUNE ?= "mips32el"

PREFERRED_PROVIDER_virtual/kernel = "linux-hd"

IMAGEVERSION := "${DISTRO_NAME}-${DISTRO_VERSION}-${DATE}"
IMAGEVERSION[vardepsexclude] = "DATE"

IMAGE_CMD_ubi_append = " \
	mkdir -p ${IMGDEPLOYDIR}/${IMAGEDIR}; \
	cp ${IMGDEPLOYDIR}/${IMAGE_NAME}.rootfs.ubi ${IMGDEPLOYDIR}/${IMAGEDIR}/rootfs.bin; \
	gzip -9c ${IMGDEPLOYDIR}/vmlinux-${MACHINE}.bin > ${IMGDEPLOYDIR}/${IMAGEDIR}/kernel.bin; \
	echo "${IMAGEVERSION}" > ${IMGDEPLOYDIR}/${IMAGEDIR}/imageversion; \
	echo "rename this file to 'force' to force an update without confirmation" > ${IMGDEPLOYDIR}/${IMAGEDIR}/noforce; \
	cd ${IMGDEPLOYDIR}; \
	zip ${DISTRO_NAME}-${DISTRO_VERSION}-${MACHINE}_usb.zip ${IMAGEDIR}/*; \
	rm -Rf ${IMAGEDIR}; \
	rm -Rf ${IMGDEPLOYDIR}/boot; \
	"

IMAGE_CMD_ubi_prepend = " \
	rm -Rf ${IMGDEPLOYDIR}/boot; \
	mkdir ${IMGDEPLOYDIR}/boot; \
	echo "LABEL=${DISTRO_NAME}${DISTRO_VERSION}" > ${IMGDEPLOYDIR}/boot/boot.cfg; \
	echo "KERNEL=/boot/vmlinux.gz" >> ${IMGDEPLOYDIR}/boot/boot.cfg; \
	echo "PRIORITY=100" >> ${IMGDEPLOYDIR}/boot/boot.cfg; \
	rm -Rf ${IMAGE_ROOTFS}/tmp/*; \
	"

require conf/machine/include/tune-mips32.inc
require conf/machine/include/hd.inc
```

## conf/machine/include/hd.inc
```bitbake
MACHINE_KERNEL_PR = "r1"

KERNEL_MODULE_AUTOLOAD += "xfs"

# We know about rtc
MACHINE_FEATURES_BACKFILL_CONSIDERED = "rtc"
PREFERRED_PROVIDER_virtual/egl = "v3d-libgles-${MACHINE}"
PREFERRED_PROVIDER_virtual/libgles2 = "v3d-libgles-${MACHINE}"
PREFERRED_PROVIDER_virtual/kernel_mipsel = "linux-hd"
PREFERRED_PROVIDER_virtual/kernel_arm = "linux-hd4k"

PACKAGECONFIG_GL_pn-qtbase_arm = "gles2 eglfs"

IMAGEVERSION := "${DISTRO_NAME}-${DISTRO_VERSION}-${DATE}"
IMAGEVERSION[vardepsexclude] = "DATE"

MACHINE_ESSENTIAL_EXTRA_RDEPENDS = " \
	hd-dvb-modules-${MACHINE} \
	"

MACHINE_ESSENTIAL_EXTRA_RRECOMMENDS = " \
	kernel-module-cdfs \
	"

MACHINE_EXTRA_RRECOMMENDS = " \
	gst-plugin-dvbmediasink \
	ntfs-3g \
	"

MACHINE_FEATURES += "alsa usbhost wlan 3dtv switchoff osdposition hdmicec"

DVBMEDIASINK_CONFIG_arm = "--with-h265 --with-vb8 --with-vb9 --with-opus --with-wma --with-wmv --with-pcm --with-dts --with-eac3"
DVBMEDIASINK_CONFIG_mipsel = "--with-wma --with-wmv --with-pcm --with-dts --with-eac3 \
	${@bb.utils.contains('MACHINE', 'hd11', '--with-h265 --with-vb6 --with-vb8 --with-spark' , '', d)} \
	${@bb.utils.contains('MACHINE', 'hd1265', '--with-h265 --with-vb6 --with-vb8 --with-spark' , '', d)} \
	${@bb.utils.contains('MACHINE', 'hd1500', '--with-h265 --with-vb6 --with-vb8 --with-spark' , '', d)} \
	${@bb.utils.contains('MACHINE', 'hd530c', '--with-h265 --with-vb6 --with-vb8 --with-spark' , '', d)} \
	${@bb.utils.contains('MACHINE', 'vs1000', '--with-h265 --with-vb6 --with-vb8 --with-spark' , '', d)} \
	"

IMAGEDIR ?= "${MACHINE}"
IMGDEPLOYDIR ?= "${DEPLOY_DIR_IMAGE}"

# ARM

IMAGE_CMD_hd-emmc_append_arm = "\
	mkdir -p ${IMGDEPLOYDIR}/${IMAGEDIR}; \
	cp ${IMGDEPLOYDIR}/${IMAGE_NAME}.emmc.img ${IMGDEPLOYDIR}/${IMAGEDIR}/disk.img; \
	echo "${IMAGEVERSION}" > ${IMGDEPLOYDIR}/${IMAGEDIR}/imageversion; \
	cd ${IMGDEPLOYDIR}; \
	zip ${DISTRO_NAME}-${DISTRO_VERSION}-${MACHINE}_usb.zip ${IMAGEDIR}/*; \
	rm -Rf ${IMAGEDIR}; \
	"

# MIPSEL

IMAGE_CMD_ubi_append_mipsel = " \
	mkdir -p ${IMGDEPLOYDIR}/${IMAGEDIR}; \
	cp ${IMGDEPLOYDIR}/${IMAGE_NAME}.rootfs.ubi ${IMGDEPLOYDIR}/${IMAGEDIR}/rootfs.bin; \
	gzip -9c ${DEPLOY_DIR_IMAGE}/vmlinux-${MACHINE}.bin > ${IMGDEPLOYDIR}/${IMAGEDIR}/kernel.bin; \
	echo "${IMAGEVERSION}" > ${IMGDEPLOYDIR}/${IMAGEDIR}/imageversion; \
	echo "rename this file to 'force' to force an update without confirmation" > ${IMGDEPLOYDIR}/${IMAGEDIR}/noforce; \
	cd ${IMGDEPLOYDIR}; \
	zip ${DISTRO_NAME}-${DISTRO_VERSION}-${MACHINE}_usb.zip ${IMAGEDIR}/*; \
	rm -Rf ${IMAGEDIR}; \
	rm -Rf ${IMGDEPLOYDIR}/boot; \
	"

require conf/machine/include/hd-wifi.inc
```

## conf/machine/vs1500.conf
```bitbake
#@TYPE: Machine
#@NAME: vs1500
#@DESCRIPTION: Machine configuration for the vs1500

MACHINE_FEATURES += "dvb-c textlcd"
OPENPLI_FEATURES += "ci"

CHIPSET = "bcm7251s"
RCTYPE = "16"

require conf/machine/include/hd-armv7a.inc
```
